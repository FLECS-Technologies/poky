## build/conf/bblayers.conf
```bitbake
# POKY_BBLAYERS_CONF_VERSION is increased each time build/conf/bblayers.conf
# changes incompatibly
POKY_BBLAYERS_CONF_VERSION = "2"

BBPATH = "${TOPDIR}"
BBFILES ?= ""

BBLAYERS ?= " \
  /home/alex/git/yocto-bm/yocto-layers/meta-compat \
  /home/alex/git/yocto-bm/yocto-layers/meta-openembedded/meta-oe \
  /home/alex/git/yocto-bm/yocto-layers/meta-rust \
  /home/alex/git/yocto-bm/poky/meta \
  /home/alex/git/yocto-bm/poky/meta-poky \
  /home/alex/git/yocto-bm/poky/meta-yocto-bsp \
  /home/alex/git/yocto-bm/yocto-layers/meta-intel-fpga \
  /home/alex/git/yocto-bm/yocto-layers/meta-bmaxx-plc-di \
  /home/alex/git/yocto-bm/yocto-layers/meta-bmaxx-plc-mc \
  /home/alex/git/yocto-bm/yocto-layers/meta-xenomai \
  /home/alex/git/yocto-bm/yocto-layers/meta-flecs \
  /home/alex/git/yocto-bm/yocto-layers/meta-mono \
  /home/alex/git/yocto-bm/yocto-layers/meta-openembedded/meta-filesystems \
  /home/alex/git/yocto-bm/yocto-layers/meta-openembedded/meta-python \
  /home/alex/git/yocto-bm/yocto-layers/meta-openembedded/meta-networking \
  /home/alex/git/yocto-bm/yocto-layers/meta-openembedded/meta-webserver \
  /home/alex/git/yocto-bm/yocto-layers/meta-intel \
  /home/alex/git/yocto-bm/yocto-layers/meta-virtualization \
  /home/alex/git/yocto-bm/yocto-layers/meta-maxxos \
  "
```
